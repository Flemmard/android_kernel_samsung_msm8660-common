## arch/arm/mach-msm/htc/Kconfig.offsets
```kconfig
config PHYS_OFFSET
	hex
	default "0x48000000" if ARCH_MSM8X60
	default "0x10000000"
```

## arch/arm/mach-msm/htc/pyramid/Kconfig
```kconfig
config MACH_PYRAMID
	depends on ARCH_MSM8X60
	select MACH_HTC
	bool "HTC Pyramid"
	help
	  Support for the HTC PYRAMID device.
```
